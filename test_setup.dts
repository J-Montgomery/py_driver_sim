/dts-v1/;

/ {

	spi {
		#address-cells = <1>;
		#size-cells = <0>;
		compatible = "pysim,spi-bus";

		driver@0 {
			compatible = "vendor,devicev1";
			spi-max-frequency = <1000000>;
			reg = <0>;
		};
		simulated_hardware@0 {
			compatible = "pysim,generic-device";
			reg = <0>;
		};
	};
};
